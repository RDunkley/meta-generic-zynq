## conf/layer.conf
```bitbake
# We have a conf and classes directory, add to BBPATH
BBPATH .= ":${LAYERDIR}"

# We have recipes-* directories, add to BBFILES
BBFILES += "${LAYERDIR}/recipes-*/*/*.bb \
	${LAYERDIR}/recipes-*/*/*.bbappend"

BBFILE_COLLECTIONS += "generic-zynq"
BBFILE_PATTERN_generic-zynq = "^${LAYERDIR}/"
BBFILE_PRIORITY_generic-zynq = "6"
LAYERDEPENDS_generic-zynq = "core openembedded-layer xilinx"
LAYERSERIES_COMPAT_generic-zynq = "sumo thud"
```

## conf/machine/generic-zynq7.conf
```bitbake
###################################################################################################
# Contains a generic Zynq 7000 machine configuration that can work with any Zynq processor board or
# can be used as a template for creation of a machine configuration for a custom board. This file
# is adapted from the machine configurations provided by meta-xilinx.
###################################################################################################
#@TYPE: Machine
#@NAME: generic-zynq7
#@DESCRIPTION: Machine support for a generic board with a Zynq7 SoC.

SOC_VARIANT ?= "7z"

require conf/machine/include/tune-zynq.inc
require conf/machine/include/machine-xilinx-overrides.inc
require conf/machine/include/machine-xilinx-default.inc
require conf/machine/include/machine-xilinx-board.inc

IMAGE_FSTYPES += "wic"
WKS_FILE ?= "sdimage-zynq7.wks"

# You can add the following features to this line as needed:
#     usbhost
#     usbgadget
#     rtc
#     keyboard
#     screen
#     alsa
#     sdio
MACHINE_FEATURES = "ext4 vfat"

# The Linux kernel is switched to the one provided with Yocto. Note: the
# machine configurations that come with meta-xilinx use the Xilinx kernel
# for the zynq processor.
XILINX_DEFAULT_KERNEL_zynq := "linux-yocto"

# u-boot configuration
PREFERRED_PROVIDER_virtual/bootloader = "u-boot"
UBOOT_MACHINE = "zynq_generic_config"
SPL_BINARY = "spl/boot.bin"

EXTRA_IMAGEDEPENDS += " \
		u-boot-zynq-uenv \
		virtual/boot-bin \
		"

# Configures the serial console settings.
SERIAL_CONSOLE = "115200 ttyPS0"

MACHINE_ESSENTIAL_EXTRA_RDEPENDS += "device-tree"

IMAGE_BOOT_FILES += " \
		boot.bin \
		${MACHINE}.dtb \
		uEnv.txt \
		"
```

## wic/sdimage-zynq7.wks
```
# short-description: Create Generic Zynq SD card image
# long-description: Creates a partitioned SD card image for use with
# a Zynq-7000. Boot files are located in the first vfat partition.

part /boot --source bootimg-partition --ondisk mmcblk0 --fstype=vfat --label boot --active --align 4096 --size 64
part / --source rootfs --ondisk mmcblk0 --fstype=ext4 --label root --align 4096
```
